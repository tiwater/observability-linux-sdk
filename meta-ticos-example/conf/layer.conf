## meta-ticos-example/conf/layer.conf
```bitbake
# We have a conf and classes directory, add to BBPATH
BBPATH .= ":${LAYERDIR}"

# We have recipes-* directories, add to BBFILES
BBFILES += "${LAYERDIR}/recipes-*/*/*.bb \
            ${LAYERDIR}/recipes-*/*/*.bbappend"

BBFILE_COLLECTIONS += "ticos-example"
BBFILE_PATTERN_ticos-example = "^${LAYERDIR}/"
BBFILE_PRIORITY_ticos-example = "6"

LAYERSERIES_COMPAT_ticos-example = "kirkstone"

LAYERDEPENDS_ticos-example = "ticos"
```

## meta-ticos-example/conf/local.conf.sample
```bitbake
MACHINE ?= "qemuarm64"

DISTRO = "poky"
PACKAGE_CLASSES = "package_deb"
USER_CLASSES = "buildstats"
PATCHRESOLVE = "noop"

IMAGE_FSTYPES:append = " ext4.gz"

EXTRA_IMAGE_FEATURES ?= "debug-tweaks"

# Licensing
LICENSE_FLAGS_ACCEPTED = "commercial_ticosd commercial_ticos-core-handler"

# Wic file support
IMAGE_FSTYPES:append = " wic wic.bmap"
WKS_FILE = "ticos.wks"
MACHINE_ESSENTIAL_EXTRA_RDEPENDS += "kernel-image"
do_image_wic[depends] += "mtools-native:do_populate_sysroot dosfstools-native:do_populate_sysroot virtual/bootloader:do_deploy"

# Kernel configuration
KERNEL_FEATURES:append = " cgl/features/pstore/pstore.scc cfg/debug/misc/debug-panic-oops.scc"

# Bootloader
EXTRA_IMAGEDEPENDS:append = " virtual/bootloader"
PREFERRED_PROVIDER_virtual/bootloader = "u-boot"
IMAGE_BOOT_FILES = "u-boot.bin boot.scr"

# systemd system manager
DISTRO_FEATURES:append = " systemd"
DISTRO_FEATURES:remove = "sysvinit"
VIRTUAL-RUNTIME_init_manager = "systemd"
DISTRO_FEATURES_BACKFILL_CONSIDERED:append = "sysvinit"
VIRTUAL-RUNTIME_initscripts = ""

# Versioning env variables
TICOS_BASE_URL:pn-ticosd := "${@d.getVar('BB_ORIGENV', False).getVar('TICOS_BASE_URL')}"
TICOS_PROJECT_KEY:pn-ticosd := "${@d.getVar('BB_ORIGENV', False).getVar('TICOS_PROJECT_KEY')}"
TICOS_SOFTWARE_TYPE:pn-ticosd := "${@d.getVar('BB_ORIGENV', False).getVar('TICOS_SOFTWARE_TYPE')}"
TICOS_SOFTWARE_VERSION:pn-ticosd := "${@d.getVar('BB_ORIGENV', False).getVar('TICOS_SOFTWARE_VERSION')}"

TICOS_DEVICE_ID:pn-ticos-device-info := "${@d.getVar('BB_ORIGENV', False).getVar('TICOS_DEVICE_ID')}"
TICOS_HARDWARE_VERSION:pn-ticos-device-info := "${@d.getVar('BB_ORIGENV', False).getVar('TICOS_HARDWARE_VERSION')}"

# Used by swupdate package to populate the 09-swupdate-args.in template file:
TICOS_HARDWARE_VERSION:pn-swupdate := "${@d.getVar('BB_ORIGENV', False).getVar('TICOS_HARDWARE_VERSION')}"

# Used by swupdate-image to populate the sw-description.in template file:
TICOS_SOFTWARE_VERSION:pn-swupdate-image := "${@d.getVar('BB_ORIGENV', False).getVar('TICOS_SOFTWARE_VERSION')}"
TICOS_HARDWARE_VERSION:pn-swupdate-image := "${@d.getVar('BB_ORIGENV', False).getVar('TICOS_HARDWARE_VERSION')}"


# Support runqemu script
QB_DEFAULT_FSTYPE = "wic"
QB_DRIVE_TYPE = "/dev/vdb"
QB_SYSTEM_NAME = "qemu-system-arm"
QB_DEFAULT_BIOS = "u-boot.bin"
QB_MEM = "512M"
```

## meta-ticos/conf/layer.conf
```bitbake
# We have a conf and classes directory, add to BBPATH
BBPATH .= ":${LAYERDIR}"

# We have a recipes directory, add to BBFILES
BBFILES += "${LAYERDIR}/recipes-*/*/*.bb \
    ${LAYERDIR}/recipes-*/*/*.bbappend"

BBFILE_COLLECTIONS += "ticos"
BBFILE_PATTERN_ticos := "^${LAYERDIR}/"
BBFILE_PRIORITY_ticos = "6"

LAYERSERIES_COMPAT_ticos = "kirkstone"

LAYERDEPENDS_swupdate = "openembedded-layer swupdate"
PREFERRED_VERSION_swupdate = "2022.05"
PREFERRED_VERSION_collectd = "5.12.0"

MACHINE_ESSENTIAL_EXTRA_RRECOMMENDS:append = " \
    collectd \
    curl \
    ticosd \
    ticos-core-handler \
    swupdate \
    swupdate-tools-ipc \
    swupdate-tools-hawkbit \
"
```
